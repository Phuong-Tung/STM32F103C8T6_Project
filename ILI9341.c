#include "ILI9341.h"

extern SPI_HandleTypeDef hspi1;

const uint8_t font5x7[] = {
    0x00,0x00,0x00,0x00,0x00, 0x00,0x00,0x5F,0x00,0x00, 0x00,0x07,0x00,0x07,0x00, 0x14,0x7F,0x14,0x7F,0x14,
    0x24,0x2A,0x7F,0x2A,0x12, 0x23,0x13,0x08,0x64,0x62, 0x36,0x49,0x55,0x22,0x50, 0x00,0x05,0x03,0x00,0x00,
    0x00,0x1C,0x22,0x41,0x00, 0x00,0x41,0x22,0x1C,0x00, 0x14,0x08,0x3E,0x08,0x14, 0x08,0x08,0x3E,0x08,0x08,
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    0x00,0x00,0x7F,0x00,0x00, 0x00,0x41,0x36,0x08,0x00, 0x10,0x08,0x08,0x10,0x08
};



static void ILI9341_WriteCommand(uint8_t cmd) {
    HAL_GPIO_WritePin(ILI9341_DC_PORT, ILI9341_DC_PIN, GPIO_PIN_RESET);
    HAL_GPIO_WritePin(ILI9341_CS_PORT, ILI9341_CS_PIN, GPIO_PIN_RESET);
    HAL_SPI_Transmit(&hspi1, &cmd, 1, HAL_MAX_DELAY);
    HAL_GPIO_WritePin(ILI9341_CS_PORT, ILI9341_CS_PIN, GPIO_PIN_SET);
}

static void ILI9341_WriteData(uint8_t data) {
    HAL_GPIO_WritePin(ILI9341_DC_PORT, ILI9341_DC_PIN, GPIO_PIN_SET);
    HAL_GPIO_WritePin(ILI9341_CS_PORT, ILI9341_CS_PIN, GPIO_PIN_RESET);
    HAL_SPI_Transmit(&hspi1, &data, 1, HAL_MAX_DELAY);
    HAL_GPIO_WritePin(ILI9341_CS_PORT, ILI9341_CS_PIN, GPIO_PIN_SET);
}

static void ILI9341_Reset(void) {
    HAL_GPIO_WritePin(ILI9341_RST_PORT, ILI9341_RST_PIN, GPIO_PIN_RESET);
    HAL_Delay(20);
    HAL_GPIO_WritePin(ILI9341_RST_PORT, ILI9341_RST_PIN, GPIO_PIN_SET);
    HAL_Delay(150);
}

void ILI9341_Init(SPI_HandleTypeDef *hspi) {
    ILI9341_Reset();

    ILI9341_WriteCommand(0x01); // Software reset
    HAL_Delay(100);

    ILI9341_WriteCommand(0x28); // Display OFF

    ILI9341_WriteCommand(0xCF);
    ILI9341_WriteData(0x00); ILI9341_WriteData(0xC1); ILI9341_WriteData(0x30);

    ILI9341_WriteCommand(0xED);
    ILI9341_WriteData(0x64); ILI9341_WriteData(0x03); ILI9341_WriteData(0x12); ILI9341_WriteData(0x81);

    ILI9341_WriteCommand(0xE8);
    ILI9341_WriteData(0x85); ILI9341_WriteData(0x00); ILI9341_WriteData(0x78);

    ILI9341_WriteCommand(0xCB);
    ILI9341_WriteData(0x39); ILI9341_WriteData(0x2C); ILI9341_WriteData(0x00);
    ILI9341_WriteData(0x34); ILI9341_WriteData(0x02);

    ILI9341_WriteCommand(0xF7);
    ILI9341_WriteData(0x20);

    ILI9341_WriteCommand(0xEA);
    ILI9341_WriteData(0x00); ILI9341_WriteData(0x00);

    ILI9341_WriteCommand(0xC0); ILI9341_WriteData(0x23); // Power control
    ILI9341_WriteCommand(0xC1); ILI9341_WriteData(0x10); // Power control
    ILI9341_WriteCommand(0xC5); ILI9341_WriteData(0x3e); ILI9341_WriteData(0x28); // VCM control
    ILI9341_WriteCommand(0xC7); ILI9341_WriteData(0x86); // VCM control2

    ILI9341_WriteCommand(0x36); ILI9341_WriteData(0xA8); // Memory Access Control: MX, BGR
    ILI9341_WriteCommand(0x3A); ILI9341_WriteData(0x55); // Pixel Format Set: 16 bits/pixel

    ILI9341_WriteCommand(0xB1); ILI9341_WriteData(0x00); ILI9341_WriteData(0x18); // Frame rate

    ILI9341_WriteCommand(0xB6); // Display Function Control
    ILI9341_WriteData(0x08); ILI9341_WriteData(0x82); ILI9341_WriteData(0x27);

    ILI9341_WriteCommand(0xF2); ILI9341_WriteData(0x00); // 3Gamma Function Disable
    ILI9341_WriteCommand(0x26); ILI9341_WriteData(0x01); // Gamma curve selected

    // Gamma correction
    ILI9341_WriteCommand(0xE0);
    uint8_t gamma_pos[] = {0x0F,0x31,0x2B,0x0C,0x0E,0x08,0x4E,0xF1,0x37,0x07,0x10,0x03,0x0E,0x09,0x00};
    for (int i = 0; i < sizeof(gamma_pos); i++) ILI9341_WriteData(gamma_pos[i]);

    ILI9341_WriteCommand(0xE1);
    uint8_t gamma_neg[] = {0x00,0x0E,0x14,0x03,0x11,0x07,0x31,0xC1,0x48,0x08,0x0F,0x0C,0x31,0x36,0x0F};
    for (int i = 0; i < sizeof(gamma_neg); i++) ILI9341_WriteData(gamma_neg[i]);

    ILI9341_WriteCommand(0x11); // Sleep Out
    HAL_Delay(120);
    ILI9341_WriteCommand(0x29); // Display ON
}

void ILI9341_FillScreen(uint16_t color) {
    ILI9341_SetAddressWindow(0, 0, ILI9341_WIDTH - 1, ILI9341_HEIGHT - 1);

    uint8_t data[2] = { color >> 8, color & 0xFF };
    HAL_GPIO_WritePin(ILI9341_DC_PORT, ILI9341_DC_PIN, GPIO_PIN_SET);
    HAL_GPIO_WritePin(ILI9341_CS_PORT, ILI9341_CS_PIN, GPIO_PIN_RESET);

    for (uint32_t i = 0; i < ILI9341_WIDTH * ILI9341_HEIGHT; i++) {
        HAL_SPI_Transmit(&hspi1, data, 2, HAL_MAX_DELAY);
    }

    HAL_GPIO_WritePin(ILI9341_CS_PORT, ILI9341_CS_PIN, GPIO_PIN_SET);
}


void ILI9341_SetAddressWindow(uint16_t x0, uint16_t y0, uint16_t x1, uint16_t y1) {
    ILI9341_WriteCommand(0x2A); // Column addr set
    ILI9341_WriteData(x0 >> 8);
    ILI9341_WriteData(x0 & 0xFF);
    ILI9341_WriteData(x1 >> 8);
    ILI9341_WriteData(x1 & 0xFF);

    ILI9341_WriteCommand(0x2B); // Row addr set
    ILI9341_WriteData(y0 >> 8);
    ILI9341_WriteData(y0 & 0xFF);
    ILI9341_WriteData(y1 >> 8);
    ILI9341_WriteData(y1 & 0xFF);

    ILI9341_WriteCommand(0x2C); // Write to RAM
}

void ILI9341_DrawPixel(uint16_t x, uint16_t y, uint16_t color) {
    ILI9341_SetAddressWindow(x, y, x, y);
    uint8_t data[] = {color >> 8, color & 0xFF};
    HAL_GPIO_WritePin(ILI9341_DC_PORT, ILI9341_DC_PIN, GPIO_PIN_SET);
    HAL_GPIO_WritePin(ILI9341_CS_PORT, ILI9341_CS_PIN, GPIO_PIN_RESET);
    HAL_SPI_Transmit(&hspi1, data, 2, HAL_MAX_DELAY);
    HAL_GPIO_WritePin(ILI9341_CS_PORT, ILI9341_CS_PIN, GPIO_PIN_SET);
}

void ILI9341_DrawChar(uint16_t x, uint16_t y, char ch, uint16_t color, uint16_t bg, uint8_t scale) {
    if (ch < 32 || ch > 126) return;

    for (int i = 0; i < 5; i++) {
        uint8_t line = font5x7[(ch - 32) * 5 + i];
        for (int j = 0; j < 8; j++) {
            uint16_t drawColor = (line & 0x01) ? color : bg;
            for (uint8_t dx = 0; dx < scale; dx++) {
                for (uint8_t dy = 0; dy < scale; dy++) {
                    ILI9341_DrawPixel(x + i * scale + dx, y + j * scale + dy, drawColor);
                }
            }
            line >>= 1;
        }
    }

    // V? kho?ng cách gi?a ký t? (c?t tr?ng)
    for (int j = 0; j < 8 * scale; j++) {
        for (uint8_t dx = 0; dx < scale; dx++) {
            ILI9341_DrawPixel(x + 5 * scale + dx, y + j, bg);
        }
    }
}

void ILI9341_DrawString(uint16_t x, uint16_t y, const char *str, uint16_t color, uint16_t bg, uint8_t scale) {
    while (*str) {
        ILI9341_DrawChar(x, y, *str, color, bg, scale);
        x += (6 * scale);  // m?i ký t? 5 pixel + 1 kho?ng cách
        str++;
    }
}

void ILI9341_ClearRect(uint16_t x, uint16_t y, uint16_t w, uint16_t h, uint16_t color) {
    ILI9341_SetAddressWindow(x, y, x + w - 1, y + h - 1);
    uint8_t data[] = { color >> 8, color & 0xFF };
    HAL_GPIO_WritePin(ILI9341_DC_PORT, ILI9341_DC_PIN, GPIO_PIN_SET);
    HAL_GPIO_WritePin(ILI9341_CS_PORT, ILI9341_CS_PIN, GPIO_PIN_RESET);
    for (uint32_t i = 0; i < w * h; i++) {
        HAL_SPI_Transmit(&hspi1, data, 2, HAL_MAX_DELAY);
    }
    HAL_GPIO_WritePin(ILI9341_CS_PORT, ILI9341_CS_PIN, GPIO_PIN_SET);
}

void ILI9341_SetRotation(uint8_t rotation) {
    ILI9341_WriteCommand(0x36); // MADCTL

    switch (rotation % 4) {
        case 0:
            ILI9341_WriteData(0x48); // MX | BGR
            break;
        case 1:
            ILI9341_WriteData(0x28); // MV | BGR
            break;
        case 2:
            ILI9341_WriteData(0x88); // MY | BGR
            break;
        case 3:
            ILI9341_WriteData(0xE8); // MX | MY | MV | BGR
            break;
    }
}

